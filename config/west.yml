## config/west.yml
```yaml
manifest:
  remotes:
    - name: zmkfirmware
      url-base: https://github.com/zmkfirmware
  projects:
    - name: zmk
      remote: zmkfirmware
      # Используем стабильную версию v0.1 для совместимости с папкой config/boards
      revision: v0.1 
      import: app/west.yml
  self:
    path: config
```
